## firmware/sdkconfig.defaults
```kconfig
# Target
CONFIG_IDF_TARGET="esp32s3"
CONFIG_IDF_TARGET_ESP32S3=y

# Flash: 8 MB QIO @ 80 MHz
CONFIG_ESPTOOLPY_FLASHSIZE_8MB=y
CONFIG_ESPTOOLPY_FLASHMODE_QIO=y
CONFIG_ESPTOOLPY_FLASHFREQ_80M=y

# Partition table
CONFIG_PARTITION_TABLE_CUSTOM=y
CONFIG_PARTITION_TABLE_CUSTOM_FILENAME="partitions.csv"
CONFIG_PARTITION_TABLE_FILENAME="partitions.csv"

# CPU at 240 MHz
CONFIG_ESP_DEFAULT_CPU_FREQ_MHZ_240=y
CONFIG_ESP_DEFAULT_CPU_FREQ_MHZ=240

# Main task stack big enough for HTTPS+mbedTLS+app code
CONFIG_ESP_MAIN_TASK_STACK_SIZE=8192

# Logging
CONFIG_LOG_DEFAULT_LEVEL_INFO=y
CONFIG_LOG_MAXIMUM_LEVEL_DEBUG=y

# mbedTLS: enable what we need, drop what we don't to save flash/RAM.
CONFIG_MBEDTLS_HARDWARE_AES=y
CONFIG_MBEDTLS_HARDWARE_SHA=y
CONFIG_MBEDTLS_CHACHA20_C=y
CONFIG_MBEDTLS_POLY1305_C=y
CONFIG_MBEDTLS_CHACHAPOLY_C=y
CONFIG_MBEDTLS_HKDF_C=y
CONFIG_MBEDTLS_ECP_C=y
CONFIG_MBEDTLS_ECDH_C=y
CONFIG_MBEDTLS_ECP_DP_CURVE25519_ENABLED=y
CONFIG_MBEDTLS_TLS_CLIENT_ONLY=y
CONFIG_MBEDTLS_TLS_SERVER=n
CONFIG_MBEDTLS_SSL_PROTO_TLS1_2=y
CONFIG_MBEDTLS_SSL_PROTO_TLS1_3=y

# HTTP client + TLS
CONFIG_ESP_TLS_USING_MBEDTLS=y
CONFIG_ESP_HTTP_CLIENT_ENABLE_HTTPS=y
# Mozilla CA bundle so Let's Encrypt certificates "just work".
CONFIG_MBEDTLS_CERTIFICATE_BUNDLE=y
CONFIG_MBEDTLS_CERTIFICATE_BUNDLE_DEFAULT_FULL=y

# Wi-Fi: sane defaults
CONFIG_ESP_WIFI_STATIC_RX_BUFFER_NUM=10
CONFIG_ESP_WIFI_DYNAMIC_RX_BUFFER_NUM=32
CONFIG_ESP_WIFI_DYNAMIC_TX_BUFFER_NUM=32

# NVS encryption - will turn on later together with eFuse-based flash
# encryption. For now NVS lives in cleartext (still inside flash-encrypted
# region once we enable that downstream).
CONFIG_NVS_ENCRYPTION=n

# Newlib: stdout via USB CDC
CONFIG_ESP_CONSOLE_USB_SERIAL_JTAG=y

# FreeRTOS tick
CONFIG_FREERTOS_HZ=1000
```
